#include "Arduino.h"
#include "stc_isr_context.h"
#include "stc_sfr.h"
#include "stc_usb_service.h"

/*
 * Timer0 supplies the Arduino time base. All
 * selected families expose the 1T timer clock. One millisecond always fits
 * in the 16-bit counter for the clock choices generated by this platform.
 */
#ifndef STC_TIMER0_CLOCK_DIVIDER
# if STC_CORE_TIMER1_IS_1T
#  define STC_TIMER0_CLOCK_DIVIDER 1UL
#else
#  define STC_TIMER0_CLOCK_DIVIDER 12UL
# endif
#endif

#if (STC_TIMER0_CLOCK_DIVIDER != 1UL) && \
    (STC_TIMER0_CLOCK_DIVIDER != 6UL) && \
    (STC_TIMER0_CLOCK_DIVIDER != 12UL)
# error "STC_TIMER0_CLOCK_DIVIDER must be 1, 6, or 12"
#endif

#define STC_TIMER0_TICKS_PER_MS \
    ((F_CPU + (STC_TIMER0_CLOCK_DIVIDER * 500UL)) / \
     (STC_TIMER0_CLOCK_DIVIDER * 1000UL))
#define STC_TIMER0_RELOAD (65536UL - STC_TIMER0_TICKS_PER_MS)

#if (STC_TIMER0_TICKS_PER_MS < 1UL) || (STC_TIMER0_TICKS_PER_MS > 65535UL)
# error "F_CPU cannot produce a 1 ms Timer0 tick"
#endif

volatile unsigned long stc_timer0_millis_count;

static void stc_timer0_load(void)
{
    TH0 = (uint8_t)(STC_TIMER0_RELOAD >> 8);
    TL0 = (uint8_t)STC_TIMER0_RELOAD;
}

void stc_timer0_isr(void) __interrupt (1)
{
    STC_ISR_CONTEXT_ENTER();
    TCON &= (uint8_t)~STC_TCON_TF0;
    ++stc_timer0_millis_count;
    STC_ISR_CONTEXT_LEAVE();
}

void init(void)
{
#if STC_CORE_MEMORY_TIMING_LAYOUT == 1
    /* Official STC32G/AI8051U SDK startup. ISP can leave both registers at
     * 7, multiplying instruction and XRAM access latency. These timing
     * registers do not change oscillator/UART/Timer0 frequency. */
# if F_CPU <= 40000000UL
    WTST = 0u;
# endif
    CKCON = 0u;
#endif
#if STC_CORE_HAS_PORT8 || STC_CORE_HAS_PORT9 || \
    STC_CORE_HAS_PORTA || STC_CORE_HAS_PORTB
    /*
     * This target uses a linear 24-bit data map. Enabling EAXFR once exposes
     * the independent 0x7e0000 XFR region without aliasing its internal XRAM.
     */
    P_SW2 |= STC_P_SW2_EAXFR;
    CKCON = 0u;
    TM0PS = 0u;
# if F_CPU <= 64000000UL
    WTST = 1u;
# elif F_CPU <= 90000000UL
    WTST = 2u;
# elif F_CPU <= 120000000UL
    WTST = 3u;
#else
    WTST = 4u;
# endif
#endif


    TCON &= (uint8_t)~STC_TCON_TR0;

    /* STC mode 0: 16-bit auto reload. */
    TMOD &= 0xf0u;

# if STC_TIMER0_CLOCK_DIVIDER == 1UL
    AUXR |= STC_AUXR_T0_1T;
# elif STC_TIMER0_CLOCK_DIVIDER == 12UL
    AUXR &= (uint8_t)~STC_AUXR_T0_1T;
#else
#  error "The selected MCS251 board requires a 1T or 12T timer"
# endif

    stc_timer0_millis_count = 0UL;
    stc_timer0_load();
    TCON &= (uint8_t)~STC_TCON_TF0;
    IE |= (STC_IE_ET0 | STC_IE_EA);
    TCON |= STC_TCON_TR0;
}

void yield(void)
{
    if (stc_usb_service) stc_usb_service();
}

void interrupts(void)
{
    IE |= STC_IE_EA;
}

void noInterrupts(void)
{
    IE &= (uint8_t)~STC_IE_EA;
}

unsigned long millis(void)
{
    uint8_t enabled = IE & STC_IE_EA;
    unsigned long value;

    IE &= (uint8_t)~STC_IE_EA;
    value = stc_timer0_millis_count;
    if ((TCON & STC_TCON_TF0) != 0u) {
        ++value;
    }
    if (enabled != 0u) {
        IE |= STC_IE_EA;
    }
    return value;
}

void delay(unsigned long milliseconds)
{
    unsigned long start = millis();

    while ((unsigned long)(millis() - start) < milliseconds) {
        yield();
    }
}
